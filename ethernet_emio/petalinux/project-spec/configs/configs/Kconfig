## ethernet_emio/petalinux/project-spec/configs/configs/Kconfig
```kconfig
mainmenu "PetaLinux System Configuration"
config SUBSYSTEM_TYPE_LINUX
        bool
        default y
        select SYSTEM_ZYNQ

config SYSTEM_ZYNQ
        bool "ZYNQ Configuration"
        help
          ZYNQ Configuration for petalinux project.
          All these config options will be in /home/zhenyz/git/zynq7000_examples/ethernet_emio/petalinux/project-spec/configs/config

config SUBSYSTEM_DISTRO_PETALINUX
        bool
        default y
        help

source /home/zhenyz/git/zynq7000_examples/ethernet_emio/petalinux/project-spec/configs/configs/Kconfig.main
```
